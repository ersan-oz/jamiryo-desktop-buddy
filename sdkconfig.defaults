## sdkconfig.defaults
```kconfig
CONFIG_IDF_TARGET="esp32s3"
CONFIG_LWIP_MAX_SOCKETS=16
CONFIG_ESPTOOLPY_FLASHSIZE_8MB=y
CONFIG_ESPTOOLPY_FLASHMODE_QIO=y
CONFIG_ESPTOOLPY_FLASHFREQ_80M=y
CONFIG_SPIRAM=y
CONFIG_SPIRAM_MODE_OCT=y
CONFIG_SPIRAM_SPEED_80M=y
CONFIG_SPIRAM_BOOT_INIT=y
CONFIG_SPIRAM_MEMTEST=y
CONFIG_SPIRAM_USE_MALLOC=y
# Medium protocol buffers belong in PSRAM; preserve internal DMA-capable RAM
# for audio, Wi-Fi and hardware AES while the setup/update server is open.
CONFIG_SPIRAM_MALLOC_ALWAYSINTERNAL=2048
CONFIG_ESP_CONSOLE_USB_SERIAL_JTAG=y
CONFIG_ESP_CONSOLE_SECONDARY_NONE=y
CONFIG_LOG_COLORS=n
CONFIG_PARTITION_TABLE_CUSTOM=y
CONFIG_PARTITION_TABLE_CUSTOM_FILENAME="partitions.csv"
CONFIG_MBEDTLS_CERTIFICATE_BUNDLE=y
CONFIG_MBEDTLS_CERTIFICATE_BUNDLE_DEFAULT_FULL=y
CONFIG_MBEDTLS_CERTIFICATE_BUNDLE_CROSS_SIGNED_VERIFY=y
CONFIG_LWIP_TCP_SND_BUF_DEFAULT=32768
CONFIG_LWIP_TCP_WND_DEFAULT=32768
CONFIG_LWIP_TCP_RECVMBOX_SIZE=25
CONFIG_GC0308_SUPPORT=y
CONFIG_SCCB_HARDWARE_I2C_PORT0=y
CONFIG_CAMERA_TASK_STACK_SIZE=4096
CONFIG_FLASH_HUMAN_FACE_DETECT_MSRMNP_S8_V1=y
CONFIG_HUMAN_FACE_DETECT_MSRMNP_S8_V1=y
CONFIG_HUMAN_FACE_DETECT_MODEL_IN_FLASH_PARTITION=y
CONFIG_FLASH_HUMAN_FACE_FEAT_MFN_S8_V1=y
CONFIG_HUMAN_FACE_FEAT_MFN_S8_V1=y
CONFIG_HUMAN_FACE_FEAT_MODEL_IN_FLASH_PARTITION=y
CONFIG_COMPILER_OPTIMIZATION_SIZE=y
CONFIG_BOOTLOADER_APP_ROLLBACK_ENABLE=y
# Camera/model preprocessing uses RGB565 and RGB888 only. Disabling unused
# conversion templates makes room for both OTA slots without changing models.
CONFIG_PIX_CVT_RGB565_TO_RGB565_SUPPORT=n
CONFIG_PIX_CVT_RGB565_TO_GRAY_SUPPORT=n
CONFIG_PIX_CVT_RGB565_TO_HSV_SUPPORT=n
CONFIG_PIX_CVT_RGB888_TO_RGB565_SUPPORT=n
CONFIG_PIX_CVT_RGB888_TO_GRAY_SUPPORT=n
CONFIG_PIX_CVT_RGB888_TO_HSV_SUPPORT=n
CONFIG_PIX_CVT_GRAY_TO_GRAY_SUPPORT=n
CONFIG_PIX_CVT_HSV_TO_HSV_MASK_SUPPORT=n
CONFIG_PIX_CVT_YUV_TO_RGB888_SUPPORT=n
CONFIG_PIX_CVT_YUV_TO_RGB565_SUPPORT=n
CONFIG_PIX_CVT_YUV_TO_GRAY_SUPPORT=n
CONFIG_PIX_CVT_YUV_TO_HSV_SUPPORT=n
CONFIG_PIX_CVT_YUV_TO_YUV_SUPPORT=n
CONFIG_MBEDTLS_EXTERNAL_MEM_ALLOC=y
CONFIG_LWIP_DNS_SUPPORT_MDNS_QUERIES=y
```
